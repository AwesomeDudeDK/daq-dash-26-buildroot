## buildroot/package/dash/Config.in
```kconfig
config BR2_PACKAGE_DASH
	bool "dash"
	depends on BR2_INSTALL_LIBSTDCPP
	depends on BR2_PACKAGE_MESA3D_GALLIUM_DRIVER_V3D
	depends on BR2_PACKAGE_MESA3D_GBM
	depends on BR2_PACKAGE_MESA3D_OPENGL_ES
	depends on BR2_PACKAGE_MESA3D_OPENGL_GLX
	depends on BR2_PACKAGE_LIBGPIOD2
	select BR2_PACKAGE_LIBDRM
	help
	  NFR26 dashboard controller application, built with Okay Engine.
	  Installs to /opt/dash and starts at boot.

if BR2_PACKAGE_DASH

config BR2_PACKAGE_DASH_OKAY_ENGINE_DIR
	string "Okay Engine checkout"
	default "$(HOME)/okay-engine-27"
	help
	  Path to the okay-engine repository (the directory containing okay/).

config BR2_PACKAGE_DASH_BUILD_TYPE
	string "build type"
	default "Release"
	help
	  Debug or Release.

endif

comment "dash needs mesa3d (v3d, gbm, OpenGL ES, OpenGL GLX) and libgpiod2"
	depends on !BR2_PACKAGE_MESA3D_GALLIUM_DRIVER_V3D || \
		!BR2_PACKAGE_MESA3D_GBM || !BR2_PACKAGE_MESA3D_OPENGL_ES || \
		!BR2_PACKAGE_MESA3D_OPENGL_GLX || !BR2_PACKAGE_LIBGPIOD2
```
